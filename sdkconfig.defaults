## sdkconfig.defaults
```kconfig
CONFIG_ESPTOOLPY_FLASHSIZE_4MB=y
CONFIG_MICRO_ROS_ESP_EMBEDDEDRTPS_MIDDLEWARE=y
CONFIG_ESP32_SPIRAM_SUPPORT=y
CONFIG_ESP_MAIN_TASK_STACK_SIZE=3000
CONFIG_ESP_INT_WDT_TIMEOUT_MS=300
# CONFIG_ESP_TASK_WDT is not set
```
